## firmware/dongle-usb-bth/sdkconfig.defaults
```kconfig
CONFIG_IDF_TARGET="esp32s3"

# 日志走 UART0（GPIO43/44 = 串口桥 USB 口），与 USB 数据口隔离
CONFIG_ESP_CONSOLE_UART_DEFAULT=y

# 蓝牙：仅控制器（无主机栈），BLE-only，HCI 传输层由固件提供（指向 USB bth 类）
CONFIG_BT_ENABLED=y
CONFIG_BT_CONTROLLER_ONLY=y
CONFIG_BT_CTRL_HCI_MODE_UART_H4=y
CONFIG_BT_CTRL_BLE_ADV_REPORT_FLOW_CTRL_SUPP=n
CONFIG_BT_CTRL_BLE_SCAN_DUPL=n
```
